## fw/boards/hagzey/som/board.yml
```yaml
board:
  name: som
  full_name: Hagzey STM32 System on Module
  vendor: hagzey
  socs:
    - name: stm32h743xx
```

## fw/som/build/Kconfig/Kconfig.shield
```kconfig
osource "/home/adamhage/Projects/stm32_system_on_module/fw/som/boards/shields/*/Kconfig.shield"
```

## fw/som/build/Kconfig/arch/Kconfig.tmp
```kconfig
# Load Zephyr Arch Kconfig descriptions.
osource "/home/adamhage/zephyrproject/zephyr/arch/rx/Kconfig"
osource "/home/adamhage/zephyrproject/zephyr/arch/x86/Kconfig"
osource "/home/adamhage/zephyrproject/zephyr/arch/xtensa/Kconfig"
osource "/home/adamhage/zephyrproject/zephyr/arch/sparc/Kconfig"
osource "/home/adamhage/zephyrproject/zephyr/arch/riscv/Kconfig"
osource "/home/adamhage/zephyrproject/zephyr/arch/posix/Kconfig"
osource "/home/adamhage/zephyrproject/zephyr/arch/openrisc/Kconfig"
osource "/home/adamhage/zephyrproject/zephyr/arch/mips/Kconfig"
osource "/home/adamhage/zephyrproject/zephyr/arch/arm64/Kconfig"
osource "/home/adamhage/zephyrproject/zephyr/arch/arm/Kconfig"
osource "/home/adamhage/zephyrproject/zephyr/arch/arc/Kconfig"
```

## fw/som/build/Kconfig/boards/Kconfig
```kconfig
# Load Zephyr board Kconfig descriptions.
osource "/home/adamhage/Projects/stm32_system_on_module/fw/som/boards/hagzey/som/Kconfig"
```

## fw/som/build/Kconfig/boards/Kconfig.defconfig.tmp
```kconfig
# Load Zephyr board defconfig descriptions.
osource "/home/adamhage/Projects/stm32_system_on_module/fw/som/boards/hagzey/som/Kconfig.defconfig"
```
